/dts-v1/;  
/plugin/;  

/{  
   compatible = "ti,beaglebone", "ti,beaglebone-green", "ti,beaglebone-black";  
   part-number = "PRU1";
   version = "00A0";
   exclusive-use =  
   "pru1";  
  
   fragment@0 {
        target = <&pruss>;
        __overlay__ {
            pru1_pins_pinmux {
                status = "okay";
            };
        };
   };

};  
  
  
